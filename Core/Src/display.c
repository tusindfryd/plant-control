#include "display.h"

I2C_HandleTypeDef hi2c2;

const unsigned char bg[] = { 0x0f, 0x1e, 0x02, 0x04, 0x90, 0x20, 0x3c, 0x78,
		0x08, 0x12, 0x40, 0x80, 0xf1, 0xe0, 0x20, 0x49, 0x18, 0xe3, 0x02, 0x08,
		0x88, 0x20, 0x63, 0x8c, 0x08, 0x22, 0x20, 0x81, 0x8e, 0x30, 0x20, 0x88,
		0x10, 0x41, 0x03, 0x10, 0x84, 0x60, 0x41, 0x04, 0x0c, 0x42, 0x11, 0x81,
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		0x80, 0x00, 0x00, 0x08, 0x1f, 0x02, 0x00, 0x00 };

const unsigned char garfield1_128x64[] = { 0x00, 0x00, 0x00, 0x00, 0x00, 0x00,
		0x00, 0x00, 0x00, 0x00, 0x00, 0x00, 0x00, 0x00, 0x00, 0x00, 0x00, 0x00,
		0x00, 0x00, 0x00, 0x00, 0x00, 0x00, 0x00, 0x00, 0x00, 0x00, 0x00, 0x00,
		0x00, 0x00, 0x00, 0x00, 0x00, 0x00, 0x00, 0x00, 0x00, 0x00, 0x00, 0x00,
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		0x00, 0x00, 0x00, 0x00, 0x00, 0x00, };

extern uint16_t WS9527_Reading;
extern uint16_t BH1750_Reading;
extern double Lamp_Setpoint;
bool menu_open = false;
extern volatile uint16_t positions;

void Splash() {
	ssd1306_Init();
	ssd1306_DrawBitmap(0, 0, bg, 128, 64, White);
	ssd1306_UpdateScreen();
}

void DisplayMeasurements() {
	BackgroundRectangle();
	ssd1306_SetCursor(0, 15);
	char moisture_data[21];
	if (WS9527_Reading < 10) {
		sprintf(moisture_data, "Soil moisture: %01d%%  ", WS9527_Reading);
		ssd1306_WriteString(moisture_data, Font_7x10, White);
	} else if (WS9527_Reading < 100) {
		sprintf(moisture_data, "Soil moisture: %02d%% ", WS9527_Reading);
		ssd1306_WriteString(moisture_data, Font_7x10, White);
	} else {
		sprintf(moisture_data, "Soil moisture: %03d%%", WS9527_Reading);
		ssd1306_WriteString(moisture_data, Font_7x10, White);
	}
	ssd1306_SetCursor(0, 26);
	char light_data[22];
	if (BH1750_Reading < 10) {
		sprintf(light_data, "Brightness: %01d lx  ", BH1750_Reading);
		ssd1306_WriteString(light_data, Font_7x10, White);
	} else if (BH1750_Reading < 100) {
		sprintf(light_data, "Brightness: %02d lx ", BH1750_Reading);
		ssd1306_WriteString(light_data, Font_7x10, White);
	} else if (BH1750_Reading < 1000) {
		sprintf(light_data, "Brightness: %03d lx", BH1750_Reading);
		ssd1306_WriteString(light_data, Font_7x10, White);
	} else {
		sprintf(light_data, "Brightness: %04d lx", BH1750_Reading);
		ssd1306_WriteString(light_data, Font_7x10, White);
	}
	ssd1306_SetCursor(0, 37);
	char setpoint_str[22];
	if (Lamp_Setpoint < 10) {
		sprintf(setpoint_str, "Setpoint: %01d lx  ", (int) Lamp_Setpoint);
		ssd1306_WriteString(setpoint_str, Font_7x10, White);
	} else if (Lamp_Setpoint < 100) {
		sprintf(setpoint_str, "Setpoint: %02d lx ", (int) Lamp_Setpoint);
		ssd1306_WriteString(setpoint_str, Font_7x10, White);
	} else if (Lamp_Setpoint < 1000) {
		sprintf(setpoint_str, "Setpoint: %03d lx", (int) Lamp_Setpoint);
		ssd1306_WriteString(setpoint_str, Font_7x10, White);
	} else {
		sprintf(setpoint_str, "Setpoint: %04d lx", (int) Lamp_Setpoint);
		ssd1306_WriteString(setpoint_str, Font_7x10, White);
	}
	ssd1306_UpdateScreen();
}

void OpenMenu() {
	menu_open = true;
	ssd1306_Fill(Black);
	ssd1306_SetCursor(0, 0);
	ssd1306_WriteString("Turn lamp on/off", Font_7x10,
			(positions % 2 == 0) ? Black : White);
	ssd1306_SetCursor(0, 64 - 10);
	ssd1306_WriteString("< Back", Font_7x10,
			(positions % 2 == 1) ? Black : White);
	ssd1306_UpdateScreen();
}

void CloseMenu() {
	menu_open = false;
	ssd1306_Fill(Black);
	ssd1306_DrawBitmap(0, 0, bg, 128, 64, White);
	BackgroundRectangle();
	DisplayMeasurements();
}

void BackgroundRectangle() {
	for (uint8_t i = 10; i < 51; i++) {
		ssd1306_Line(0, i, SSD1306_WIDTH, i, Black);
	}
}
